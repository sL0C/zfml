&i2c1 {
    status = "okay";
    sda-pin = <30>;
    scl-pin = <31>;
    oled: ssd1306@3c {
        compatible = "solomon,ssd1306fb";
        reg = <0x3C>;
        width = <128>;
        height = <32>;
        segment-offset = <0>;
        display-offset = <0>;
        multiplex-ratio = <31>;
        reset-gpios = <&gpio0 10 GPIO_ACTIVE_LOW>;
        label = "SSD1306";
    };
};
